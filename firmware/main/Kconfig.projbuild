## firmware/main/Kconfig.projbuild
```kconfig
menu "CAN Do Configuration"

    config CAN_DO_DEVICE_IDENTIFIER
        string "Vehicle / Device Identifier (leave empty for can-do-[MAC])"
        default ""
        help
            Unique ID used for Home Assistant MQTT Auto-Discovery grouping.
            If left empty, defaults to can-do-(last 4 hex digits of Wi-Fi MAC), e.g. can-do-3A8F.

    config CAN_DO_WIFI_SSID
        string "Wi-Fi SSID"
        default ""
        help
            SSID of the home Wi-Fi or in-vehicle phone hotspot.

    config CAN_DO_WIFI_PASSWORD
        string "Wi-Fi Password"
        default ""
        help
            Password for the Wi-Fi network.

    config CAN_DO_AP_SSID
        string "Fallback SoftAP SSID"
        default "CAN-Do-Edge"
        help
            Access Point SSID broadcast when station connection fails or is unconfigured.

    config CAN_DO_AP_PASSWORD
        string "Fallback SoftAP Password"
        default "candorules"
        help
            Access Point password (minimum 8 characters).

    config CAN_DO_MQTT_BROKER_URL
        string "MQTT Broker URL"
        default "mqtt://homeassistant.local:1883"
        help
            URL of MQTT broker (e.g. mqtt://192.168.1.50:1883 or mqtt://homeassistant.local:1883).

    config CAN_DO_MQTT_USERNAME
        string "MQTT Username"
        default ""

    config CAN_DO_MQTT_PASSWORD
        string "MQTT Password"
        default ""

endmenu
```
